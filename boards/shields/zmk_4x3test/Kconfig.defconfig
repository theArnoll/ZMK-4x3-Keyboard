## boards/shields/zmk_4x3test/Kconfig.defconfig
```kconfig
if SHIELD_ZMK_4X3TEST

# Name must be less than 16 characters long!
config ZMK_KEYBOARD_NAME
    default "Arnoll 4x3 KB"

# config SPI
#     default y
# https://zmk.dev/docs/development/hardware-integration/shift-registers
# https://github.com/petejohanson/revxlp-config/blob/main/config/boards/shields/revxlp/Kconfig.defconfig

choice ZMK_HID_REPORT_TYPE
    default ZMK_HID_REPORT_TYPE_NKRO
endchoice

config ZMK_BLE
    bool
    default y

endif
```
