/ {
    physical_layout0: physical_layout_0 {
        compatible = "zmk,physical-layout";
        display-name = "Default Layout";
        transform = <&default_transform>;
    };
    keypad_position_map {
        compatible = "zmk,physical-layout-position-map";
        complete;
        physical_map: physical {
            physical-layout = <&physical_layout0>;
            positions // This is equivalent to `positions = <0 1 2 3>;`, reshaped for readability
                = < 0 >;// 1  2 >
                // , < 3  4  5 >
                // , < 6  7  8 >;
                // , < 9 10 11 >;
        };
    };
};