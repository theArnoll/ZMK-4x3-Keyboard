#include "<board>-pinctrl.dtsi"

// https://zmk.dev/docs/development/hardware-integration/shift-registers#shift-register-spi-device
&spi0 {
    /* enables this PIO block */
    status = "okay";
    shifter0: gpio_ext_595 {
        /* Assign pinctrl to node */
        pinctrl-0 = <&pio0_spi_default>;
        pinctrl-names = "default";
        compatible = "raspberrypi,pico-spi-pio";
        #address-cells = <1>;
        #size-cells = <0>;
        clocks = <&system_clk>;
        clock-frequency = <4000000>;
        /* These pins should be the same as in pinctrl */
        miso-gpios = <&gpio0 4 0>; // ???
        clk-gpios = <&gpio0 2 GPIO_ACTIVE_HIGH>;
        mosi-gpios = <&gpio0 3 GPIO_ACTIVE_HIGH>;

        cs-gpios = <&gpio0 5 GPIO_ACTIVE_LOW>; // List of chip select gpios, one for each device
        /* Nodes using the bus go here */
    };
};

/* ---------- SPI 總線與 74HC595 定義 ----------
&spi0 {
    status = "okay";
    cs-gpios = <&gpio0 5 GPIO_ACTIVE_LOW>; 

    shifter0: gpio_ext_595@0 {
        compatible = "zmk,gpio-595";
        status = "okay";
        gpio-controller;
        spi-max-frequency = <1000000>;
        reg = <0>;
        #gpio-cells = <2>;
        ngpios = <8>;
    };  
}; */