## Kconfig.shield
```kconfig
# No whitespace after the comma or in your keyboard name!
config SHIELD_ZMK-4X3TEST
    def_bool $(shields_list_contains,ZMK-4x3test)
```

## boards/shields/ZMK-4x3test/Kconfig.defconfig
```kconfig
if SHIELD_ZMK_4X3_TEST

# Name must be less than 16 characters long!
config ZMK_KEYBOARD_NAME
    default "ZMK-4x3test"

# config SPI
#     default y

endif
```

## boards/shields/zmk_4x3test/Kconfig.shield
```kconfig
config ZMK_4X3TEST
    def_bool $(shields_list_contains,zmk_4x3test)
    select SPI
    # https://github.com/petejohanson/revxlp-config/blob/main/config/boards/shields/revxlp/Kconfig.shield
```

## config/west.yml
```yaml
manifest:
  remotes:
    - name: zmkfirmware
      url-base: https://github.com/zmkfirmware
    # Additional modules containing boards/shields/custom code can be listed here as well
    # See https://docs.zephyrproject.org/3.2.0/develop/west/manifest.html#projects
    - name: ZMK-4x3test_base
      url-base: https://github.com/theArnoll
  projects:
    - name: zmk
      remote: zmkfirmware
      revision: main
      import: app/west.yml
    - name: ZMK-4x3test
      remote: ZMK-4x3test_base
      revision: main
  self:
    path: config
```
